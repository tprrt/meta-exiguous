## meta-tupi/conf/machine/tupi-nas-b75m.conf
```bitbake
#
# -*- coding: utf-8; tab-width: 4; c-basic-offset: 4; indent-tabs-mode: nil -*-

#@TYPE: Machine
#@NAME: Homemade CI/NAS/Media server

#@DESCRIPTION:
# - Intel i5-3570K 3.3GHz
# - Motherboard Asrock B75M-ITX
#   - Gigabit LAN 10/100/1000 Mb/s Realtek RTL8111E
# - x2 DDR3 4GB F3-1600C9D-8GAB
# - RAID 1 soft (root)
#  - x2 SSD 64GB Samsung 830
# - RAID 10 hardware (data)
#  - RAID Controller LSI MEGARAID SAS 9240-4
#  - x4 HDD 2TB Seagate Barracuda 64MiB 7200tr/min
# - JBOD soft (backup)
#  - x2 HDD 2TB Seagate Barracuda 64MiB 7200tr/min

require conf/machine/intel-corei7-64.conf

MACHINEOVERRIDES =. "tupi-nas-b75m:"
```

## meta-tupi/conf/machine/tupi-nas.conf
```bitbake
#
# -*- coding: utf-8; tab-width: 4; c-basic-offset: 4; indent-tabs-mode: nil -*-

#@TYPE: Machine
#@NAME: Homemade CI/NAS/Media server

#@DESCRIPTION:
# - Intel i5-3570K 3.3GHz
# - Motherboard Asrock B75M-ITX
#   - Gigabit LAN 10/100/1000 Mb/s Realtek RTL8111E
# - x2 DDR3 4GB F3-1600C9D-8GAB
# - RAID 1 soft (root)
#  - x2 SSD 64GB Samsung 830
# - RAID 10 hardware (data)
#  - RAID Controller LSI MEGARAID SAS 9240-4
#  - x4 HDD 2TB Seagate Barracuda 64MiB 7200tr/min
# - JBOD soft (backup)
#  - x2 HDD 2TB Seagate Barracuda 64MiB 7200tr/min

DEFAULTTUNE = "corei7-64"

require conf/machine/include/meta-intel.inc
require conf/machine/include/intel-corei7-64-common.inc
require conf/machine/include/intel-common-pkgarch.inc

# Multilib is required to build u-boot on x86_64 64bits
require conf/multilib.conf
MULTILIBS = "multilib:lib32"
DEFAULTTUNE_virtclass-multilib-lib32 = "x86"

PREFERRED_PROVIDER_virtual/bootloader = "u-boot"
PREFERRED_VERSION_u-boot = "v2016.03%"
# UBOOT_MACHINE = ""

PREFERRED_PROVIDER_virtual/kernel = "linux-stable"
PREFERRED_VERSION_linux-stable = "4.4%"

SERIAL_CONSOLES = "115200;ttyDBG"

MACHINE_HWCODECS = "va-intel gstreamer-vaapi-1.0"

XSERVER = ""

# FIXME [tupi] Enable the support of USB Null-Modem cable

# -----------------------------------------------------------------------------

MACHINE_FEATURES_remove = "wifi bluetooth 3g nfc screen keyboard alsa usbgadget"

MACHINE_FEATURES_append = " pcbios efi va-impl-intel intel-ucode softraid"
```

## meta-tupi/conf/machine/tupi-router-bbb.conf
```bitbake
#
# -*- coding: utf-8; tab-width: 4; c-basic-offset: 4; indent-tabs-mode: nil -*-

#@TYPE: Machine
#@NAME: Homemade router

#@DESCRIPTION:
# - Beagle Bone Black rev.B
# - D-Link USB 2.0 Fast Ethernet Adapter (DUB-E100)
# - Wifi (802.11n) USB 2.0 Adapter

require conf/machine/beaglebone.conf

MACHINEOVERRIDES =. "tupi-router-bbb:"
```

## meta-tupi/conf/machine/tupi-router.conf
```bitbake
#
# -*- coding: utf-8; tab-width: 4; c-basic-offset: 4; indent-tabs-mode: nil -*-

#@TYPE: Machine
#@NAME: Homemade router

#@DESCRIPTION:
# - Beagle Bone Black rev.B
# - D-Link USB 2.0 Fast Ethernet Adapter (DUB-E100)
# - Wifi (802.11n) USB 2.0 Adapter

DEFAULTTUNE = "cortexa8thf-neon"

require conf/machine/include/ti33x.inc

MACHINEOVERRIDES = "beaglebone:tupi-router"

PREFERRED_PROVIDER_virtual/bootloader = "u-boot"
PREFERRED_VERSION_u-boot = "v2016.03%"
UBOOT_MACHINE = "am335x_boneblack_config"

PREFERRED_PROVIDER_virtual/kernel = "linux-stable-security"
PREFERRED_VERSION_linux-stable-security = "4.1%"

IMAGE_FSTYPES = "tar.gz"

SERIAL_CONSOLES = "115200;ttyO0"

MACHINE_FEATURES = "apm usbhost sgx wifi"

MACHINE_EXTRA_RRECOMMENDS = ""

XSERVER = ""
```

## meta-tupi/conf/machine/tupi-x220.conf
```bitbake
#
# -*- coding: utf-8; tab-width: 4; c-basic-offset: 4; indent-tabs-mode: nil -*-

#@TYPE: Machine
#@NAME: Laptop Thinkpad X220

#@DESCRIPTION:
# - Intel i5-2540M 2.6GHz
# - x2 DDR3 4GB 10700
# - SSD Samsung 830 64GB
# - Display 12.5" HD LED IPS TFT 1366x768
# - Gigabit LAN Intel PRO/1000 LAN
# - Wi-Fi a/g/n
# - DisplayPort, VGA
# - Li-ion 9 cellules
# - Trackpoint, touchpad

DEFAULTTUNE = "corei7-64"

require conf/machine/include/meta-intel.inc
require conf/machine/include/intel-corei7-64-common.inc
require conf/machine/include/intel-common-pkgarch.inc

PREFERRED_PROVIDER_virtual/bootloader = "u-boot"
PREFERRED_VERSION_u-boot = "v2016.03%"
# UBOOT_MACHINE = ""

PREFERRED_PROVIDER_virtual/kernel = "linux-stable-security"
PREFERRED_VERSION_linux-stable-security = "4.1%"

SERIAL_CONSOLES = "115200;ttyDBG"

MACHINE_HWCODECS = "va-intel gstreamer-vaapi-1.0"

XSERVER = "${XSERVER_X86_BASE} \
           ${XSERVER_X86_EXT} \
           ${XSERVER_X86_I965} \
          "

# -----------------------------------------------------------------------------

MACHINE_FEATURES_remove = "3g nfc"

MACHINE_FEATURES_append = " pcbios efi va-impl-intel intel-ucode wifi bluetooth screen keyboard alsa usbgadget"
```
