## meta-exiguous/conf/distro/exiguous.conf
```bitbake
#
# -*- coding: utf-8; tab-width: 4; c-basic-offset: 4; indent-tabs-mode: nil -*-

require conf/distro/poky-tiny.conf
require conf/distro/include/security_flags.inc

LOCALCONF_VERSION = "2"

DISTRO = "exiguous"
DISTRO_NAME = "Exiguous powered by OpenEmbedded/Yocto"
DISTROOVERRIDES = "poky:exiguous"

# -----------------------------------------------------------------------------
# Bitbake configuration
# -----------------------------------------------------------------------------

SDK_VENDOR = "-${DISTRO}sdk"
SDK_NAME_PREFIX = "${DISTRO}"
SDK_VERSION = "${DISTRO_VERSION}"
SDK_NAME = "${DISTRO}-${TCLIBC}-${SDK_ARCH}-${IMAGE_BASENAME}-${TUNE_PKGARCH}-${MACHINE}"

MAINTAINER = "Thomas Perrot <thomas.perrot@tupi.fr>"

TARGET_VENDOR = "-${DISTRO}"

# -----------------------------------------------------------------------------
# Inherited distribution configuration
# -----------------------------------------------------------------------------

PACKAGE_CLASSES = "package_rpm"

# A list of classes to globally inherit.
# These classes are used by the OpenEmbedded build system to enable extra features.
USER_CLASSES_append = " image-mklibs image-prelink"

# -----------------------------------------------------------------------------
# Distribution configuration
# -----------------------------------------------------------------------------

# Toolchain configuration
# =============================================================================

# Main toolchain configuration
# ----------------------------

# By default poky-tiny uses musl libc instead of glibc
TCLIBC = "glibc"

# By default poky uses the latest kernel's headers
# LINUXLIBCVERSION = "4.8"

# Don't want ldconfig in the target runtime
USE_LDCONFIG_class-target = "0"

# PREFERRED_PROVIDER_virtual/libc = "${TCLIBC}"
# DISTRO_FEATURES_BACKFILL_CONSIDERED_append = " glibc"

# TOOLCHAIN = "gcc"
# Use clang/llvm toolchain provide by meta-clang layer
# TOOLCHAIN = "clang"
# PREFERRED_PROVIDER_gcc-cross-initial-${TARGET_ARCH} = "${TOOLCHAIN}-cross-${TARGET_ARCH}"
# PREFERRED_PROVIDER_virtual/${TARGET_PREFIX}gcc-initial = "${TOOLCHAIN}-cross-${TARGET_ARCH}"

# Secondary toolchain configuration
# ---------------------------------

# TOOLCHAIN_pn-<recipe-name> = "clang"
# DEPENDS_append_pn-<recipe-name> = "clang-cross-${TARGET_ARCH}"

# Misc toolchain configuration
# ----------------------------

# CFLAGS_append = " -O3"
# CXXFLAGS_append = " -O3"

# FIXME [exiguous] Re-enable ls-is-gold, there is a issue with setools
# DISTRO_FEATURES_append = " ld-is-gold"

# Bootloader configuration
# =============================================================================

PREFERRED_PROVIDER_virtual/bootloader = "u-boot"
PREFERRED_VERSION_u-boot = "v2016.11%"

# Kernel configuration
# =============================================================================

PREFERRED_PROVIDER_virtual/kernel = "linux-stable"
PREFERRED_VERSION_linux-stable = "4.8%"

PREFERRED_VERSION_linux-libc-headers ?= "${LINUXLIBCVERSION}"
PREFERRED_VERSION_nativesdk-linux-libc-headers ?= "${LINUXLIBCVERSION}"

# To run extra pass during kernel compilation in order to build the initramfs
# NB. INITRAMFS_IMAGE_BUNDLE should be set in a configuration file and never in a recipe file.
# INITRAMFS_IMAGE = "exiguous-image-initramfs"
# INITRAMFS_IMAGE_BUNDLE = "1"

# System configuration
# =============================================================================

# VIRTUAL-RUNTIME_login_manager ?= "busybox"
# NB: It is also redefined in packagegroup-core-boot.bbappend
VIRTUAL-RUNTIME_login_manager = "busybox"
DISTRO_FEATURES_remove = "toybox"
DISTRO_FEATURES_BACKFILL_CONSIDERED_append = " toybox"

# VIRTUAL-RUNTIME_init_manager ?= "sysvinit"
# NB: It is also redefined in packagegroup-core-boot.bbappend
VIRTUAL-RUNTIME_init_manager = "systemd"
DISTRO_FEATURES_remove = "sysvinit"
DISTRO_FEATURES_append = " systemd"
DISTRO_FEATURES_BACKFILL_CONSIDERED_append = " sysvinit"

# NB: It is also redefined in packagegroup-core-boot.bbappend
VIRTUAL-RUNTIME_initscripts = ""

PREFERRED_PROVIDER_jpeg = "jpeg"
PREFERRED_PROVIDER_jpeg-native = "jpeg-native"

# FIXME [exiguous] Re-enable recipes adding users
# INHERIT += "extrausers"
# EXTRA_USERS_PARAMS = "\
#     usermod -p '$1$o1z3TKMG$v49npeAHkjaMoGkRIZVVJ1' root; \
# "

# Distro features configuration
# =============================================================================

# Specifies a list of distro-specific features to INSTALL to ALL images.
# NB: package-core-boot is redefined in this layer.
POKY_DEFAULT_EXTRA_RDEPENDS = ""
DISTRO_EXTRA_RDEPENDS_append = " \
    packagegroup-base \
    packagegroup-core-boot \
    packagegroup-exiguous-core \
    "

# Specifies a list of distro-specific packages to INSTALL to ALL images.
DISTRO_EXTRA_RRECOMMENDS_append = ""

# FIXME [exiguous] usbhost usbutils usbgadget
# The software support you want in your distribution for various features.
DISTRO_FEATURES_append = " ${DISTRO_EXTRA_RDEPENDS} ${DISTRO_EXTRA_RRECOMMENDS} ${DISTRO_FEATURES_LIBC}"

DISTRO_FEATURES_remove = "wifi bluetooth nfc packagegroup-base-extended"

# Features from (DISTRO|MACHINE)_FEATURES_BACKFILL that should not be backfilled
# (i.e. added to (DISTRO|MACHINE)_FEATURES) during the build.
DISTRO_FEATURES_BACKFILL_CONSIDERED_append = " package-base-extended"
MACHINE_FEATURES_BACKFILL_CONSIDERED_append = " package-base-extended"

# Raise an error when uid and gid values are not defined
USERADD_ERROR_DYNAMIC = "1"

# The addition of users or groups that have static uid and gid values.
# USERADDEXTENSION = "useradd-staticids"

# Image features
# =============================================================================

IMAGE_CLASSES += "exiguous-image_types"

# Specifies the formats the OpenEmbedded build system uses during the build
# when creating the root filesystem.
# NB. Poky-tiny's configuration overwrites the value provided by the machine's configuration
INITRAMFS_FSTYPES = "cpio cpio.lz4"
IMAGE_FSTYPES = "squashfs-lz4"

# INITRD_IMAGE specifies the image recipe that should be built to provide the
# initial RAM disk image.
INITRD_IMAGE = "exiguous-image-initramfs"

# Specifies a list of distro-specific features to INSTALL to ALL core images.
# By default, all images of Exiguous that can use, contain features below:
# IMAGE_FEATURES_append = " hwcodecs read-only-rootfs ssh-server-dropbear nfs-server"

# FIXME [exiguous] Add openssh to BACKFILL CONSIDERED... ?
IMAGE_FEATURES_REPLACES_ssh-server-dropbear = "ssh-server-openssh"
# IMAGE_FEATURES_remove = "ssh-server-openssh"
# IMAGE_INSTALL_remove = "packagegroup-core-ssh-openssh"

# Disable wide char support
ENABLE_WIDEC = "false"
ENABLE_WIDEC_class-native = "true"

# Drop native language support
USE_NLS="no"

# Linguas
# =============================================================================

# Variable that controls which locales for glibc are generated during the build
# (useful if the target device has 64Mbytes of RAM or less).
ENABLE_BINARY_LOCALE_GENERATION = "0"

# LOCALE_UTF8_ONLY = "1"

# Specifies the list of GLIBC locales to generate should you not wish generate
# all LIBC locals, which can be time consuming.
# GLIBC_GENERATE_LOCALES = "en_US.UTF-8"

# -----------------------------------------------------------------------------
# QA
# -----------------------------------------------------------------------------

# Exiguous sanity check
# =============================================================================

INHERIT += "exiguous-sanity"

# Distro features check
# =============================================================================

INHERIT += "distro_features_check"

# QA check settings - more stricter than the Yocto defaults
WARN_TO_ERROR_QA = "${WARN_QA}"

REQUIRED_DISTRO_FEATURES_append = " ${DISTRO_EXTRA_RDEPENDS}"

CONFLICT_DISTRO_FEATURES_append = " busybox sysvinit packagegroup-core-ssh-openssh"

# Build history
# =============================================================================

# To help you maintain the quality of your build output
INHERIT += "buildhistory"
BUILDHISTORY_COMMIT = "1"
BUILDHISTORY_DIR = "${TOPDIR}/buildhistory"

# Distro security check
# =============================================================================

# To run buck-security-native on rootfs built, result publish in the file
# ${T}/log.do_checksecurity.${PID}
# INHERIT += "check_security"

# Test
# =============================================================================

# Automatically runs the series of automated tests for images when an image is
# successfully built.
# INHERIT += "testimage"
# TEST_IMAGE = "1"
# TEST_LOG_DIR = "${WORKDIR}/testimage"
# TEST_SUITES = ""

# -----------------------------------------------------------------------------
# Misc configurations
# -----------------------------------------------------------------------------

QEMU_TARGETS = "x86_64 arm"

# XSERVER = ""

SANITY_TESTED_DISTROS += "Exiguous-* \n"

# Delete the work directory used for building a package once the package is built.
INHERIT += "rm_work"
```

## meta-exiguous/conf/distro/include/exiguous_security_flags.inc
```bitbake
# SECURITY_CFLAGS_pn-krb5 = "${SECURITY_NO_PIE_CFLAGS}"

SECURITY_STRINGFORMAT_pn-makedumpfile = ""
```

## meta-exiguous/conf/layer.conf
```bitbake
#
# -*- coding: utf-8; tab-width: 4; c-basic-offset: 4; indent-tabs-mode: nil -*-

# We have a conf and classes directory, add to BBPATH
BBPATH =. "${LAYERDIR}:"

# We have recipes-* directories, add to BBFILES
BBFILES += "${LAYERDIR}/recipes-*/*/*.bb \
            ${LAYERDIR}/recipes-*/*/*.bbappend"

BBFILE_COLLECTIONS += "exiguous"
BBFILE_PATTERN_exiguous = "^${LAYERDIR}/"
BBFILE_PRIORITY_exiguous = "12"

# This should only be incremented on significant changes that will
# cause compatibility issues with other layers
LAYERVERSION_exiguous = "1"

# List of Exiguous base distribution's dependencies
LAYERDEPENDS_exiguous = "core \
                         yocto \
                         openembedded-layer \
                         meta-initramfs \
                         systemd-layer \
                         virtualization-layer \
                        "

# Override security flags
require conf/distro/include/exiguous_security_flags.inc
```

## meta-exiguous/conf/machine/qemu-exiguous.conf
```bitbake
#
# -*- coding: utf-8; tab-width: 4; c-basic-offset: 4; indent-tabs-mode: nil -*-

#@TYPE: Machine
#@NAME: A custom Qemux86-64 to check Exiguous distribution

require conf/machine/qemux86-64.conf

MACHINEOVERRIDES =. "qemu-exiguous:"

PREFERRED_PROVIDER_virtual/kernel = "linux-stable"
PREFERRED_VERSION_linux-stable = "4.8%"
```

## meta-heart/conf/machine/heart-rpi.conf
```bitbake
#
# -*- coding: utf-8; tab-width: 4; c-basic-offset: 4; indent-tabs-mode: nil -*-

#@TYPE: Machine
#@NAME: HomE Automation sTation

#@DESCRIPTION:
# - Raspberry PI rev.B
#   - SDRAM 512MB
# - SDcard Lexar SD Card 32GB 400X Professional UHS-I
# - I2C to GPIO modules
# - Digital sensors
# - I2C sensors
# - Analog sensors

require conf/machine/raspberrypi.conf

MACHINEOVERRIDES =. "heart-rpi:"
```

## meta-heart/conf/machine/heart_1.conf
```bitbake
#
# -*- coding: utf-8; tab-width: 4; c-basic-offset: 4; indent-tabs-mode: nil -*-

#@TYPE: Machine
#@NAME: Homemade Home Theatre PC/Game emulator

#@DESCRIPTION:
# - Raspberry PI rev.B
# - SDcard ?? 64go
# - I2C to GPIO modules
# - Digital sensors
# - I2C sensors
# - Analog sensors

require conf/machine/include/tune-arm1176jzf-s.inc
require conf/machine/include/rpi-base.inc

# -----------------------------------------------------------------------------
#
# -----------------------------------------------------------------------------

DEFAULTTUNE ?= "arm1176jzfshf"

MACHINE_FEATURES_remove = "3g nfc touchscreen"

MACHINE_FEATURES_append = " wifi"

# -----------------------------------------------------------------------------
#
# -----------------------------------------------------------------------------

MACHINEOVERRIDES = "raspberrypi:heart_1"

PREFERRED_PROVIDER_virtual/kernel = "linux-raspberrypi"
PREFERRED_VERSION_linux-raspberrypi = "3.18%"
```

## meta-tupi/conf/machine/tupi-desktop-z77.conf
```bitbake
#
# -*- coding: utf-8; tab-width: 4; c-basic-offset: 4; indent-tabs-mode: nil -*-

#@TYPE: Machine
#@NAME: Homemade Desktop

#@DESCRIPTION:
# - Cpu Intel i7-3770K 3.5GHz
# - Motherboard MSI Z77-G65
#   - Gigabit LAN 10/100/1000 Mb/s Intel 82579V
# - x4 DDR3 4GB Gskill F3-2133C9Q-16GAB
# - x1 SSD Samsung 830 250GB
# - GPU ???
# - Display Dell
# - keyboard ???
# - mouse ???
# - sound ???

require conf/machine/intel-corei7-64.conf

MACHINEOVERRIDES =. "tupi-desktop-z77:"
```

## meta-tupi/conf/machine/tupi-desktop.conf
```bitbake
#
# -*- coding: utf-8; tab-width: 4; c-basic-offset: 4; indent-tabs-mode: nil -*-

#@TYPE: Machine
#@NAME: Homemade Desktop

#@DESCRIPTION:
# - Cpu Intel i7-3770K 3.5GHz
# - Motherboard MSI Z77-G65
#   - Gigabit LAN 10/100/1000 Mb/s Intel 82579V
# - x4 DDR3 4GB Gskill F3-2133C9Q-16GAB
# - x1 SSD Samsung 830 250GB
# - GPU ???
# - Display Dell
# - keyboard ???
# - mouse ???
# - sound ???

DEFAULTTUNE = "corei7-64"

require conf/machine/include/meta-intel.inc
require conf/machine/include/intel-corei7-64-common.inc
require conf/machine/include/intel-common-pkgarch.inc

# Multilib is required to build u-boot on x86_64 64bits
require conf/multilib.conf
MULTILIBS = "multilib:lib32"
DEFAULTTUNE_virtclass-multilib-lib32 = "x86"

PREFERRED_PROVIDER_virtual/bootloader = "u-boot"
PREFERRED_VERSION_u-boot = "v2016.03%"
# UBOOT_MACHINE = ""

PREFERRED_PROVIDER_virtual/kernel = "linux-stable"
PREFERRED_VERSION_linux-stable = "4.4%"

SERIAL_CONSOLES = "115200;ttyDBG"

MACHINE_HWCODECS = "va-intel gstreamer-vaapi-1.0"

XSERVER ?= "${XSERVER_X86_BASE} \
	    ${XSERVER_X86_EXT} \
	    ${XSERVER_X86_I965} \
	   "

# -----------------------------------------------------------------------------

MACHINE_FEATURES_remove = "wifi bluetooth 3g nfc"

MACHINE_FEATURES_append = " pcbios efi va-impl-intel intel-ucode screen keyboard alsa usbgadget"
```

## meta-tupi/conf/machine/tupi-htpc-rpi2.conf
```bitbake
#
# -*- coding: utf-8; tab-width: 4; c-basic-offset: 4; indent-tabs-mode: nil -*-

#@TYPE: Machine
#@NAME: Homemade HTPC/Game emulator

#@DESCRIPTION:
# - Raspberry PI 2 rev.B
# - microSD 8GB ???
# - Keyboard and mouse Logitech MK520
# - Dongle USB bluetooth
# - Playstation Dualshock 3

require conf/machine/raspberrypi2.conf

MACHINEOVERRIDES =. "tupi-htpc-rpi2:"
```

## meta-tupi/conf/machine/tupi-htpc.conf
```bitbake
#
# -*- coding: utf-8; tab-width: 4; c-basic-offset: 4; indent-tabs-mode: nil -*-

#@TYPE: Machine
#@NAME: Homemade HTPC/Game emulator

#@DESCRIPTION:
# - Raspberry PI 2 rev.B
# - microSD 8GB ???
# - Keyboard and mouse Logitech MK520
# - Dongle USB bluetooth
# - Playstation Dualshock 3

DEFAULTTUNE = "arm1176jzfshf"

require conf/machine/include/tune-arm1176jzf-s.inc
require conf/machine/include/rpi-base.inc

MACHINEOVERRIDES = "raspberrypi2:tupi-htpc"

PREFERRED_PROVIDER_virtual/bootloader = "u-boot"
PREFERRED_VERSION_u-boot = "v2016.03%"
UBOOT_MACHINE = "rpi_b"

PREFERRED_PROVIDER_virtual/kernel = "linux-raspberrypi"
PREFERRED_VERSION_linux-raspberrypi = "4.1%"

IMAGE_FSTYPES = "tar.bz2 ext3 rpi-sdimg"

SERIAL_CONSOLES = "115200;ttyAMA0"

MACHINE_FEATURES = "kernel26 apm usbhost keyboard screen alsa bluetooth wifi sdio"

MACHINE_EXTRA_RRECOMMENDS = ""
```

## meta-tupi/conf/machine/tupi-laptop-x220.conf
```bitbake
#
# -*- coding: utf-8; tab-width: 4; c-basic-offset: 4; indent-tabs-mode: nil -*-

#@TYPE: Machine
#@NAME: Laptop Thinkpad X220

#@DESCRIPTION:
# - Intel i5-2540M 2.6GHz
# - x2 DDR3 4GB 10700
# - SSD Samsung 830 64GB
# - Display 12.5" HD LED IPS TFT 1366x768
# - Gigabit LAN Intel PRO/1000 LAN
# - Wi-Fi a/g/n
# - DisplayPort, VGA
# - Li-ion 9 cellules
# - Trackpoint, touchpad

require conf/machine/intel-corei7-64.conf

MACHINEOVERRIDES =. "tupi-laptop-x220:"
```
