## meta-ergo/conf/layer.conf
```bitbake
#
# -*- coding: utf-8; tab-width: 4; c-basic-offset: 4; indent-tabs-mode: nil -*-

# We have a conf and classes directory, add to BBPATH
BBPATH =. "${LAYERDIR}:"

# We have recipes-* directories, add to BBFILES
BBFILES += "${LAYERDIR}/recipes-*/*/*.bb \
	    ${LAYERDIR}/recipes-*/*/*.bbappend"

BBFILE_COLLECTIONS += "ergo"
BBFILE_PATTERN_ergo = "^${LAYERDIR}/"
BBFILE_PRIORITY_ergo = "10"

# This should only be incremented on significant changes that will
# cause compatibility issues with other layers
LAYERVERSION_ergo = "1"

LAYERDEPENDS_ergo = "core yocto ros"
```

## meta-ergo/conf/machine/ergo-bbb.conf
```bitbake
#
# -*- coding: utf-8; tab-width: 4; c-basic-offset: 4; indent-tabs-mode: nil -*-

#@TYPE: Machine
#@NAME: Ergo v2.2

#@DESCRIPTION:
# - Beagle Bone Black rev.B
#   - DDR3 512MB
#   - eMMC 4GB
#   - Wifi (802.11n) USB 2.0 Adapter
#   - DFRobot Romeo V1.1 SPI
#     - x4 DC geared Motors
#     - x2 Wheel encoders
#     - x3 Ultrasonic sensors
#     - x3 IR sensors
#   - I2C to GPIO modules
#   - Ambient sensors

require conf/machine/beaglebone.conf

MACHINEOVERRIDES =. "ergo-bbb:"
```

## meta-ergo/conf/machine/ergo-rpi.conf
```bitbake
#
# -*- coding: utf-8; tab-width: 4; c-basic-offset: 4; indent-tabs-mode: nil -*-

#@TYPE: Machine
#@NAME: Ergo v1.2

#@DESCRIPTION:
# - Raspberry PI rev.B
#   - SDRAM 512MB
#   - SDcard Lexar SD Card 32GB 400X Professional UHS-I
#   - Wifi (802.11n) USB 2.0 Adapter
#   - DFRobot Romeo V1.1 USB serial
#     - x4 DC geared Motors
#     - x2 Wheel encoders
#     - x3 Ultrasonic sensors
#     - x3 IR sensors
#   - I2C to GPIO modules
#   - Ambient sensors

require conf/machine/raspberrypi.conf

MACHINEOVERRIDES =. "ergo-rpi:"
```

## meta-ergo/conf/machine/ergo_1.conf
```bitbake
#
# -*- coding: utf-8; tab-width: 4; c-basic-offset: 4; indent-tabs-mode: nil -*-

#@TYPE: Machine
#@NAME: Homemade HTPC/Game emulator

#@DESCRIPTION:
# - Raspberry PI rev.B (OS based on OpenEmbedded/Yocto)
# - SDcard ?? 64go
# - DFRobot Romeo v1 USB serial (Firmware based on ChibiOS + specific kernel Linux driver)
# - 4x DC geared Motors
# - 3x Ultrasonic sensors
# - I2C to GPIO modules
# - Ambient sensors

require conf/machine/include/tune-arm1176jzf-s.inc
require conf/machine/include/rpi-base.inc

# -----------------------------------------------------------------------------
#
# -----------------------------------------------------------------------------

DEFAULTTUNE ?= "arm1176jzfshf"

MACHINE_FEATURES_remove = "3g nfc touchscreen"

MACHINE_FEATURES_append = " wifi bluetooth"

SERIAL_CONSOLE = "115200 ttyAMA0"
SERIAL_CONSOLES = "115200;ttyAMA0"

# -----------------------------------------------------------------------------
#
# -----------------------------------------------------------------------------

MACHINEOVERRIDES = "raspberrypi:ergo_1"

PREFERRED_PROVIDER_virtual/kernel = "linux-raspberrypi"
PREFERRED_VERSION_linux-raspberrypi = "3.18%"
```

## meta-ergo/conf/machine/ergo_2.conf
```bitbake
#
# -*- coding: utf-8; tab-width: 4; c-basic-offset: 4; indent-tabs-mode: nil -*-

#@TYPE: Machine
#@NAME: Homemade router

#@DESCRIPTION:
# - Beagle Bone Black rev.B (OS based on OpenEmbedded/Yocto)
# - micro SDcard ?? 32go
# - DFRobot Romeo v1 USB serial (Firmware based on ChibiOS + specific kernel Linux driver)
# - 4x DC geared Motors
# - 3x Ultrasonic sensors
# - 3x IR Sensors
# - I2C to GPIO modules
# - Ambient sensors

require conf/machine/include/ti33x.inc

# -----------------------------------------------------------------------------
#
# -----------------------------------------------------------------------------

# Only has DVI connector for external screen
GUI_MACHINE_CLASS = "bigscreen"

IMAGE_FSTYPES += "tar.gz"

SERIAL_CONSOLE = "115200 ttyO0"
SERIAL_CONSOLES = "115200;ttyO0"

UBOOT_MACHINE = "am335x_boneblack_config"

MACHINE_FEATURES_remove = "3g nfc screen keyboard alsa usbgadget touchscreen"
MACHINE_FEATURES_append = " wifi bluetooth"

XSERVER = ""

# -----------------------------------------------------------------------------
#
# -----------------------------------------------------------------------------

MACHINEOVERRIDES = "beaglebone:ergo_2"

PREFERRED_PROVIDER_virtual/kernel = "linux-ti-staging"
PREFERRED_VERSION_linux-ti-staging = "4.1%"
```

## meta-exiguous-bsp/conf/layer.conf
```bitbake
#
# -*- coding: utf-8; tab-width: 4; c-basic-offset: 4; indent-tabs-mode: nil -*-

# We have a conf and classes directory, add to BBPATH
BBPATH =. "${LAYERDIR}:"

# We have recipes-* directories, add to BBFILES
BBFILES += "${LAYERDIR}/recipes-*/*/*.bb \
            ${LAYERDIR}/recipes-*/*/*.bbappend"

BBFILE_COLLECTIONS += "exiguous-bsp"
BBFILE_PATTERN_exiguous-bsp = "^${LAYERDIR}/"
BBFILE_PRIORITY_exiguous-bsp = "10"

# This should only be incremented on significant changes that will
# cause compatibility issues with other layers
LAYERVERSION_exiguous-bsp = "1"

# List of Exiguous base distribution's dependencies
LAYERDEPENDS_exiguous-bsp = "core"
```

## meta-exiguous/conf/bblayers.conf.sample
```bitbake
# LAYER_CONF_VERSION is increased each time build/conf/bblayers.conf changes incompatibly
LCONF_VERSION = "6"

BBPATH = "${TOPDIR}"
BBFILES ?= ""

BBLAYERS = "##COREBASE##/meta \
            ##COREBASE##/meta-yocto/meta-poky \
            ##COREBASE##/meta-openembedded/meta-initramfs \
            ##COREBASE##/meta-openembedded/meta-systemd \
            ##COREBASE##/meta-openembedded/meta-oe \
            ##COREBASE##/meta-openembedded/meta-networking \
            ##COREBASE##/meta-openembedded/meta-webserver \
            ##COREBASE##/meta-virtualization \
            ##COREBASE##/meta-security \
            \
            ##COREBASE##/meta-tprrt/meta-exiguous \
            ##COREBASE##/meta-tprrt/meta-ergo \
            ##COREBASE##/meta-tprrt/meta-heart \
            ##COREBASE##/meta-tprrt/meta-tupi \
           "

# Dependencies of meta-networking layer
BBLAYERS += "##COREBASE##/meta-openembedded/meta-python"

# Dependency of meta-security layer
BBLAYERS += "##COREBASE##/meta-openembedded/meta-perl \
             ##COREBASE##/meta-openembedded/meta-filesystems \
            "

# Layers dependencies for meta-ergo, meta-heart and meta-tupi
BBLAYERS += "##COREBASE##/meta-tprrt/meta-exiguous-bsp \
             ##COREBASE##/meta-intel \
             ##COREBASE##/meta-raspberrypi \
             ##COREBASE##/meta-ti \
            "

# Dependencies of meta-intel layer
BBLAYERS += "##COREBASE##/meta-yocto/meta-yocto-bsp"

# Layer only need to run oe-selftest
BBLAYERS += "##COREBASE##/meta-selftest"

BBLAYERS_NON_REMOVABLE = "##COREBASE##/meta \
                          ##COREBASE##/meta-yocto/meta-poky \
                          ##COREBASE##/meta-openembedded/meta-initramfs \
                          ##COREBASE##/meta-openembedded/meta-systemd \
                          ##COREBASE##/meta-virtualization \
                          \
                          ##COREBASE##/meta-tprrt/meta-exiguous \
                          ##COREBASE##/meta-tprrt/meta-exiguous-bsp \
                         "
```

## meta-exiguous/conf/distro/exiguous-rt.conf
```bitbake
#
# -*- coding: utf-8; tab-width: 4; c-basic-offset: 4; indent-tabs-mode: nil -*-

require conf/distro/exiguous.conf

DISTRO = "exiguous-rt"

PREFERRED_PROVIDER_virtual/kernel = "linux-yocto-rt"
PREFERRED_VERSION_linux-yocto-preempt-rt = "3.14%"
PREFERRED_VERSION_linux-yocto-preempt-rt_qemux86 = "3.14%"
PREFERRED_VERSION_linux-yocto-preempt-rt_qemux86-64 = "3.14%"
PREFERRED_VERSION_linux-yocto-preempt-rt_qemuarm = "3.14%"
PREFERRED_VERSION_linux-yocto-preempt-rt_qemumips = "3.14%"
PREFERRED_VERSION_linux-yocto-preempt-rt_qemumips64 = "3.14%"
PREFERRED_VERSION_linux-yocto-preempt-rt_qemuppc = "3.14%"
```
